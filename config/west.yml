## config/west.yml
```yaml
manifest:
    remotes:
        - name: zmk
          url-base: https://github.com/zmkfirmware
        - name: badjeff
          url-base: https://github.com/badjeff
        - name: sekigon
          url-base: https://github.com/sekigon-gonnoc
        - name: ek5606
          url-base: https://github.com/EK5606
    projects:
        - name: zmk
          remote: zmk
          revision: main
          import: app/west.yml
        - name: zmk-pmw3610-driver
          remote: badjeff
          revision: main
        - name: zmk-driver-paw3222
          remote: sekigon
          revision: main
        - name: zmk-unicode
          remote: ek5606
          revision: 94f1b3eefe56d6f71a43a4d8f7a57e724804399d
    self:
        path: config
```
